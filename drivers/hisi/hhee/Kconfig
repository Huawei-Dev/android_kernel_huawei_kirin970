## drivers/hisi/hhee/Kconfig
```kconfig
menu "HHEE options"

config HHEE
	bool "HHEE support"
	default n
	help
	  Say yes here to support the HHEE

config HHEE_DEBUG
	bool "HKIP HHEE test support"
	depends on !UBSAN && !KCOV && !KASAN
	depends on HHEE
	depends on HISI_DEBUG_FS
	default n
	help
	  Say yes here to support the HHEE debug

config UEFI_HHEE
	bool "HHEE support for UEFI boot"
	depends on HHEE
	default n
	help
	  Say yes here to support HHEE when kernel boot form UEFI

config HHEE_USING_IPI
	bool "HKIP HHEE Using IPI interrupt"
	depends on HHEE
	default n
	help
	  Say yes here to support using IPI not GIC

endmenu
```

## kernel/sched/hisi/Kconfig
```kconfig
#
# Enhanced options for sched walt
#

if SCHED_WALT

endif # SCHED_WALT

config SCHED_DEBUG_TRACE
	bool "Detailed trace for EAS debug"
	default n
	help
	  This option enable detailed tracepoint for EAS debug, there
	  will be more tracepoint in find best target, load balance and
	  energy diff.

config HUAWEI_SCHED_VIP
	bool "Support a high prio sched policy in fair sched class"
	default y
	depends on HISI_EAS_SCHED

config HUAWEI_SCHED_VIP_STRICT
	bool "strict vip policy"
	default n
	depends on HUAWEI_SCHED_VIP

config SCHED_HISI_TASK_MIN_UTIL
	bool "Support boosting a task to a specified opp"
	default y
	depends on SCHED_HISI_UTIL_CLAMP

config SCHED_HISI_UTIL_CLAMP
	bool "Support userspace constraints on a task's min/max opp use"
	default y
	depends on CPU_FREQ_GOV_SCHEDUTIL_OPT
	depends on HISI_EAS_SCHED
	depends on SCHED_WALT
	select SCHED_HISI_TASK_MIN_UTIL

config SCHED_DEPRECATED
	bool "Sched optimization deprecated code"
	default n
	help
	  Due to old platforms still alive, these code can't be deleted now.
	  They have been deprecated in the new platform.

	  New platform, say no. If unsure, say Y.

config SCHED_STAT_YIELD
	bool "Report task's cumulative_yield_time"
	depends on PERF_CTRL
	default n
```

## security/kernel_harden/Kconfig
```kconfig
#
# Huawei Kernel Harden
#

menu "Huawei Kernel Harden"

config HUAWEI_HIDESYMS
	bool "hide symbols"
	default n
	help
	  Hide some sensitive kernel symbols

config HUAWEI_HIDESYMS_DEBUGFS
	bool "hide symbols debugfs interface"
	depends on HUAWEI_HIDESYMS && DEBUG_FS
	default n
	help
	  Turn on the debugfs interface for hide symbols

config HW_SLUB_SANITIZE
	bool "Sanitize Slub allocations"
	depends on SLUB
	default n
	help
         Zero fill slab allocations on free, reducing the lifetime of
         sensitive data and helping to mitigate use-after-free bugs.
         For slabs with debug poisoning enabling, this has no impact.

config HUAWEI_DOUBLE_FREE_CHECK_DEBUGFS
	bool "double free check debugfs interface"
	depends on DEBUG_FS
	default n
	help
	  The debugfs interface for double free check feature.

config HUAWEI_HARDEN_DOUBLE_FREE_CHECK_DEBUGFS
	bool "harden double free check debugfs interface"
	depends on DEBUG_FS
	default n
	help
	  The debugfs interface for harden double free check feature.

config HUAWEI_FREELIST_RANDOM_DEBUGFS
	bool "freelist random debugfs interface"
	depends on DEBUG_FS
	default n
	help
	  The debugfs interface for freelist random feature.
endmenu
#a blank line must be existed
```
